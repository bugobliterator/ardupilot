/*
  raw serial-to-SD logger for AP_Periph
 */
#include "AP_Periph.h"

#if AP_PERIPH_SERIAL_LOGGER_ENABLED

#include "serial_logger.h"
#include <AP_Filesystem/AP_Filesystem.h>
#include <stdio.h>
#include <stdlib.h>
#include <fcntl.h>
#include <AP_Math/crc.h>
#if CONFIG_HAL_BOARD == HAL_BOARD_CHIBIOS
#include <hal.h>
#endif

extern const AP_HAL::HAL &hal;

const AP_Param::GroupInfo SerialLogger::var_info[] {
    // @Param: PORT
    // @DisplayName: Serial logger input port
    // @Description: SERIALn index of the UART to capture. -1 disables the logger. The port's SERIALn_PROTOCOL must be -1 (unused).
    // @Range: -1 7
    // @RebootRequired: True
    // @User: Standard
    AP_GROUPINFO("PORT", 1, SerialLogger, port, 1),

    // @Param: BAUD
    // @DisplayName: Serial logger baud rate
    // @Description: Raw baud rate of the input port. Default 5000000 (exact on both a 100 MHz and a 120 MHz UART clock, 16x oversampling). Up to 12500000 on STM32H7 boards.
    // @Range: 9600 12500000
    // @RebootRequired: True
    // @User: Standard
    AP_GROUPINFO("BAUD", 2, SerialLogger, baud, 5000000),

    // @Param: BUF_KB
    // @DisplayName: Serial logger buffer size
    // @Description: Size in KB of the RAM ring buffer that absorbs SD card write stalls. Halved automatically if it cannot be allocated.
    // @Range: 64 768
    // @RebootRequired: True
    // @User: Standard
    AP_GROUPINFO("BUF_KB", 3, SerialLogger, buf_kb, 512),

    // @Param: BENCH_KBPS
    // @DisplayName: Serial logger bench rate
    // @Description: When non-zero the logger ignores the UART receive path and writes a synthetic 32-bit counter stream at this rate in KB/s, also transmitting it on the port's TX. Used to qualify SD cards and for loopback tests.
    // @Range: 0 4000
    // @RebootRequired: True
    // @User: Advanced
    AP_GROUPINFO("BENCH_KBPS", 4, SerialLogger, bench_kbps, 0),

    // @Param: BENCH_CHUNK
    // @DisplayName: Serial logger bench chunk size
    // @Description: Bench mode only. 0 sends the counter stream in 1 ms bursts. Otherwise each wire chunk is this many bytes (1 to 256) sent as one unbuffered write, with the gap between chunks swept from 1 to 40 microseconds to exercise the receiver idle path.
    // @Range: 0 256
    // @RebootRequired: True
    // @User: Advanced
    AP_GROUPINFO("BENCH_CHUNK", 5, SerialLogger, bench_chunk, 0),

    // @Param: BENCH_LOOP
    // @DisplayName: Serial logger bench loopback
    // @Description: Bench mode only. 1 transmits the counter stream on the port's TX and records what arrives on RX through the normal receive path, for a TX-to-RX jumper test. 2 does not transmit and only records and checks what arrives, for a counter stream generated by an external sender. 0 records the generated stream directly.
    // @Values: 0:Record generated stream,1:Loopback transmit and check,2:Check external counter stream
    // @RebootRequired: True
    // @User: Advanced
    AP_GROUPINFO("BENCH_LOOP", 6, SerialLogger, bench_loop, 0),

    AP_GROUPEND
};

SerialLogger::SerialLogger()
{
    AP_Param::setup_object_defaults(this, var_info);
}


#if CONFIG_HAL_BOARD == HAL_BOARD_SITL
#define SLOG_DIR "slog"
#else
#define SLOG_DIR ""
#endif

// ponytail: fixed tuning; promote to params only if the SD bench shows they matter
#define SLOG_WRITE_BLOCK_BYTES   32768U
#define SLOG_FSYNC_MS            1000U
#define SLOG_WRITE_TIMEOUT_MS    500U
#define SLOG_READ_CHUNK_BYTES    16384U
#define SLOG_MIN_FREE_BYTES      (64U*1024U*1024U)
#define SLOG_MOUNT_RETRY_MS      3000U
#define SLOG_OPEN_RETRY_MS       1000U
#define SLOG_IDLE_CLOSE_MS       5000U   // OpenLager-style: close after this much silence
#define SLOG_STATUS_MS           1000U
#define SLOG_MIN_RING_BYTES      (64U*1024U)

void SerialLogger::init()
{
    if (port < 0) {
        return;
    }
    uart = hal.serial(port);
    if (uart == nullptr) {
        can_printf("SLOG: no serial%d", int(port));
        return;
    }

    // MEM_FILESYSTEM is the AXI SRAM heap on H7, the region FATFS can DMA from
    // directly; MEM_DMA_SAFE is the small SRAM4 heap and cannot hold the ring
    uint32_t ring_bytes = uint32_t(MAX(int16_t(64), buf_kb.get())) * 1024U;
    while (ring == nullptr && ring_bytes >= SLOG_MIN_RING_BYTES) {
        uint8_t *mem = (uint8_t *)hal.util->malloc_type(ring_bytes, AP_HAL::Util::MEM_FILESYSTEM);
        if (mem != nullptr) {
            ring = NEW_NOTHROW ByteBuffer(mem, ring_bytes);
        }
        if (ring == nullptr) {
            ring_bytes /= 2;
        }
    }
    if (ring == nullptr) {
        can_printf("SLOG: ring alloc failed");
        return;
    }
    hal.console->printf("SLOG: ring %u KB\n", unsigned(ring_bytes / 1024U));

    mounted = AP::FS().retry_mount();
#if CONFIG_HAL_BOARD == HAL_BOARD_SITL
    AP::FS().mkdir(SLOG_DIR);
#endif

    if (!hal.scheduler->thread_create(FUNCTOR_BIND_MEMBER(&SerialLogger::wr_thread, void), "SLOG_WR", 4096, AP_HAL::Scheduler::PRIORITY_IO, 0) ||
        !hal.scheduler->thread_create(FUNCTOR_BIND_MEMBER(&SerialLogger::rx_thread, void), "SLOG_RX", 2048, AP_HAL::Scheduler::PRIORITY_CAN, 1)) {
        can_printf("SLOG: thread create failed");
    }
}

/*
  writer: unmounted -> closed -> open. Never lets the ring stay full
  because of a missing card, so RTS only drops for genuine stalls.
 */
void SerialLogger::wr_thread()
{
    while (true) {
        const uint32_t now_ms = AP_HAL::millis();

        if (!mounted) {
            if (now_ms - last_mount_attempt_ms >= SLOG_MOUNT_RETRY_MS) {
                last_mount_attempt_ms = now_ms;
                mounted = AP::FS().retry_mount();
            }
            discard_ring();
            hal.scheduler->delay(10);
            report_status();
            continue;
        }

        if (fd == -1) {
            if (dump_request != 0 && ring->available() == 0) {
                const uint16_t number = dump_request;
                dump_file(number);
                dump_request = 0;
                continue;
            }
            if (ring->available() > 0 &&
                (last_open_attempt_ms == 0 || now_ms - last_open_attempt_ms >= SLOG_OPEN_RETRY_MS)) {
                if (!open_next_file()) {
                    last_open_attempt_ms = now_ms;
                    discard_ring();
                }
            }
            hal.scheduler->delay(10);
            report_status();
            continue;
        }

        const uint32_t avail = ring->available();
        if (avail == 0 && now_ms - last_write_ms >= SLOG_IDLE_CLOSE_MS) {
            // stream went quiet: close so the next stream gets its own file
            AP::FS().fsync(fd);
            close_file();
            hal.console->printf("SLOG: closed LOG%05u.TXT after idle\n", unsigned(log_number));
            continue;
        }
        if (avail >= SLOG_WRITE_BLOCK_BYTES ||
            (avail > 0 && now_ms - last_write_ms >= SLOG_WRITE_TIMEOUT_MS)) {
            if (!write_block(SLOG_WRITE_BLOCK_BYTES)) {
                write_errors++;
                close_file();
                mounted = false;
            }
        } else {
            hal.scheduler->delay(1);
        }

        if (fd != -1 && now_ms - last_fsync_ms >= SLOG_FSYNC_MS) {
            last_fsync_ms = now_ms;
            AP::FS().fsync(fd);
        }
        report_status();
    }
}

// write one contiguous run from the ring; returns false on a write error
bool SerialLogger::write_block(uint32_t max_bytes)
{
    ByteBuffer::IoVec vec[2];
    const uint8_t nvec = ring->peekiovec(vec, max_bytes);
    if (nvec == 0) {
        return true;
    }
    const uint32_t start_ms = AP_HAL::millis();
    const int32_t written = AP::FS().write(fd, vec[0].data, vec[0].len);
    if (written <= 0) {
        return false;
    }
    ring->advance(written);
    bytes_written += written;
    last_write_ms = AP_HAL::millis();
    max_write_ms = MAX(max_write_ms, last_write_ms - start_ms);
    return true;
}

void SerialLogger::discard_ring()
{
    ring->advance(ring->available());
}

bool SerialLogger::open_next_file()
{
    if (AP::FS().disk_free(SLOG_DIR "/") < int64_t(SLOG_MIN_FREE_BYTES)) {
        return false;
    }

    // next number from LASTLOG.TXT, same scheme as AP_Logger_File
    uint16_t last = 0;
    int lfd = AP::FS().open(SLOG_DIR "/LASTLOG.TXT", O_RDONLY);
    if (lfd != -1) {
        char buf[16] {};
        if (AP::FS().read(lfd, buf, sizeof(buf) - 1) > 0) {
            last = strtoul(buf, nullptr, 10);
        }
        AP::FS().close(lfd);
    }
    log_number = last + 1;

    char fname[32];
    snprintf(fname, sizeof(fname), SLOG_DIR "/LOG%05u.TXT", unsigned(log_number));
    fd = AP::FS().open(fname, O_WRONLY | O_CREAT | O_TRUNC);
    if (fd == -1) {
        return false;
    }

    lfd = AP::FS().open(SLOG_DIR "/LASTLOG.TXT", O_WRONLY | O_CREAT | O_TRUNC);
    if (lfd != -1) {
        char buf[16];
        const int len = snprintf(buf, sizeof(buf), "%u\r\n", unsigned(log_number));
        AP::FS().write(lfd, buf, len);
        AP::FS().close(lfd);
    }

    last_write_ms = last_fsync_ms = AP_HAL::millis();
    last_open_attempt_ms = 0;
    ring_high_water_bytes = 0;
    max_write_ms = 0;
    hal.console->printf("SLOG: opened %s\n", fname);
    return true;
}

/*
  stream /LOGnnnnn.TXT over the USB console port. Framing: one text line
  "SLOGDUMP <n> <size>\n", exactly <size> raw bytes, then
  "\nSLOGDUMP END <sent>\n". Console status output is muted meanwhile.
 */
#ifndef HAL_SLOG_DUMP_SERIAL
#define HAL_SLOG_DUMP_SERIAL 0
#endif

void SerialLogger::dump_file(uint16_t number)
{
    auto *usb = hal.serial(HAL_SLOG_DUMP_SERIAL);
    if (usb == nullptr) {
        dump_errors++;
        return;
    }
    if (!usb->is_initialized()) {
        usb->begin(115200);
    }
    if (dump_buf == nullptr) {
        dump_buf = (uint8_t *)malloc(4096);
        if (dump_buf == nullptr) {
            dump_errors++;
            return;
        }
    }
    char fname[32];
    snprintf(fname, sizeof(fname), SLOG_DIR "/LOG%05u.TXT", unsigned(number));
    struct stat st;
    if (AP::FS().stat(fname, &st) != 0) {
        usb->printf("SLOGDUMP %u ERROR nofile\n", unsigned(number));
        dump_errors++;
        return;
    }
    const int dfd = AP::FS().open(fname, O_RDONLY);
    if (dfd == -1) {
        usb->printf("SLOGDUMP %u ERROR open\n", unsigned(number));
        dump_errors++;
        return;
    }
    const uint32_t size = st.st_size;
    dumping = true;
    dump_bytes_sent = 0;
    usb->printf("SLOGDUMP %u %u\n", unsigned(number), unsigned(size));
    uint32_t sent = 0;
    uint32_t crc = 0;
    uint32_t last_progress_ms = AP_HAL::millis();
    while (sent < size) {
        const int32_t n = AP::FS().read(dfd, dump_buf, MIN(4096U, size - sent));
        if (n <= 0) {
            break;
        }
        crc = crc32_small(crc, dump_buf, n);
        uint32_t off = 0;
        while (off < uint32_t(n)) {
            const size_t w = usb->write(dump_buf + off, n - off);
            if (w == 0) {
                if (AP_HAL::millis() - last_progress_ms > 5000) {
                    // host stopped reading
                    dump_errors++;
                    AP::FS().close(dfd);
                    dumping = false;
                    return;
                }
                hal.scheduler->delay(1);
                continue;
            }
            off += w;
            last_progress_ms = AP_HAL::millis();
        }
        sent += n;
        dump_bytes_sent = sent;
    }
    AP::FS().close(dfd);
    hal.scheduler->delay(200);
    // crc32 of the file bytes lets the host detect any console text that
    // interleaved with the raw data
    usb->printf("\nSLOGDUMP END %u %08x\n", unsigned(sent), unsigned(crc));
    dumping = false;
}

void SerialLogger::close_file()
{
    if (fd != -1) {
        AP::FS().close(fd);
        fd = -1;
    }
}

void SerialLogger::report_status()
{
    const uint32_t now_ms = AP_HAL::millis();
    if (now_ms - last_status_ms < SLOG_STATUS_MS) {
        return;
    }
    const uint32_t dt_ms = now_ms - last_status_ms;
    last_status_ms = now_ms;
    const uint32_t rate_kbps = (bytes_written - bytes_written_at_last_status) / MAX(dt_ms, 1U);
    bytes_written_at_last_status = bytes_written;
    const uint32_t size = ring->get_size();
#if HAL_UART_STATS_ENABLED
    const uint32_t dropped = uart->get_total_dropped_rx_bytes();
#else
    const uint32_t dropped = 0;
#endif
    char line[96];
    snprintf(line, sizeof(line), "SLOG: rate=%u KB/s ring=%u%% hw=%u%% stall=%ums drop=%u werr=%u file=%u",
             unsigned(rate_kbps),
             unsigned(ring->available() * 100U / size),
             unsigned(ring_high_water_bytes * 100U / size),
             unsigned(max_write_ms),
             unsigned(dropped),
             unsigned(write_errors),
             unsigned(fd == -1 ? 0 : log_number));
    if (!dumping) {
        // the console port carries a raw file while dumping
        hal.console->printf("%s\n", line);
    }
    can_printf("%s", line);
}

/*
  bench mode: push a uint32 counter stream into the ring at bench_kbps,
  and mirror it on the UART TX for loopback tests
 */
void SerialLogger::bench_generate()
{
    const uint32_t now_ms = AP_HAL::millis();
    if (bench_last_ms == 0) {
        bench_last_ms = now_ms;
        return;
    }
    const uint32_t dt_ms = now_ms - bench_last_ms;
    bench_last_ms = now_ms;

    if (bench_chunk > 0) {
        // short wire chunks: one unbuffered write each, gap swept 1..40 us so the
        // receiver's idle detection is hit at many phases. Rate is set by the
        // chunk size and gap, not by bench_kbps.
        const uint32_t chunk = MAX(4U, MIN(uint32_t(bench_chunk.get()), 256U) & ~3U);
        for (uint8_t i = 0; i < 32; i++) {
            if (ring->space() < chunk || uart->txspace() < chunk) {
                break;
            }
            ByteBuffer::IoVec vec[2];
            const uint8_t nvec = ring->reserve(vec, chunk);
            ring->commit(fill_counter(vec, nvec, true));
            hal.scheduler->delay_microseconds(1 + (bench_gap_phase++ % 40));
        }
        return;
    }

    uint32_t budget = dt_ms * uint32_t(bench_kbps.get()) * 1024U / 1000U + bench_carry_bytes;
    budget = MIN(budget, ring->space()) & ~3U;
    bench_carry_bytes = 0;

    ByteBuffer::IoVec vec[2];
    const uint8_t nvec = ring->reserve(vec, budget);
    const uint32_t total = fill_counter(vec, nvec, true);
    ring->commit(total);
    bench_carry_bytes = budget - total;
}

/*
  bench loopback: transmit the counter stream on TX only. The ring is fed by
  the normal receive path, so the file holds exactly what came back.
 */
void SerialLogger::bench_transmit()
{
    // any chunk size from 1 byte up; the counter is emitted byte by byte so a
    // chunk may end mid-word
    const uint32_t chunk = bench_chunk > 0 ? MIN(uint32_t(bench_chunk.get()), 256U) : 256U;
    uint8_t buf[256];
    for (uint8_t i = 0; i < 32; i++) {
        const uint32_t n = MIN(chunk, uart->txspace());
        if (n == 0) {
            return;
        }
        for (uint32_t k = 0; k < n; k++) {
            buf[k] = (bench_next_value >> (8U * bench_tx_byte_index)) & 0xFF;
            if (++bench_tx_byte_index == 4) {
                bench_tx_byte_index = 0;
                bench_next_value++;
            }
        }
        const size_t written = uart->write(buf, n);
        if (written != n) {
            // txspace was checked, so this should not happen; it would show up
            // as a sequence break in the checker, so just count it
            bench_tx_short++;
        }
        if (bench_chunk > 0) {
            hal.scheduler->delay_microseconds(1 + (bench_gap_phase++ % 40));
        }
    }
}

/*
  loopback checker: the received bytes must be the little-endian uint32
  counter with no holes. On a break, count it and slide byte by byte until
  a word within 65536 of the expected value is found, then continue.
 */
void SerialLogger::bench_verify(const uint8_t *data, uint32_t len)
{
    for (uint32_t i = 0; i < len; i++) {
        vfy_buf[vfy_len++] = data[i];
        vfy_rx_offset++;
        while (vfy_len >= 4) {
            const uint32_t w = uint32_t(vfy_buf[0]) | (uint32_t(vfy_buf[1]) << 8) |
                               (uint32_t(vfy_buf[2]) << 16) | (uint32_t(vfy_buf[3]) << 24);
            uint8_t consume;
            if (!vfy_synced) {
                vfy_expected = w + 1;
                vfy_synced = true;
                consume = 4;
            } else if (w == vfy_expected) {
                vfy_expected++;
                vfy_words_ok++;
                vfy_resyncing = false;
                consume = 4;
            } else if (vfy_resyncing) {
                if (w - vfy_expected < 65536U) {
                    vfy_expected = w + 1;
                    vfy_resyncing = false;
                    consume = 4;
                } else {
                    consume = 1;
                }
            } else {
                vfy_mismatches++;
                vfy_last_bad_offset = vfy_rx_offset - vfy_len;
                if (vfy_first_bad_offset == 0) {
                    vfy_first_bad_offset = vfy_last_bad_offset;
                }
                vfy_resyncing = true;
                consume = 1;
            }
            memmove(vfy_buf, vfy_buf + consume, vfy_len - consume);
            vfy_len -= consume;
        }
    }
}

// fill reserved ring space with the little-endian uint32 counter; optionally mirror on TX
uint32_t SerialLogger::fill_counter(ByteBuffer::IoVec *vec, uint8_t nvec, bool transmit)
{
    uint32_t total = 0;
    for (uint8_t i = 0; i < nvec; i++) {
        const uint32_t nwords = vec[i].len / 4U;
        uint8_t *p = vec[i].data;
        for (uint32_t w = 0; w < nwords; w++, p += 4) {
            p[0] = bench_next_value & 0xFF;
            p[1] = (bench_next_value >> 8) & 0xFF;
            p[2] = (bench_next_value >> 16) & 0xFF;
            p[3] = (bench_next_value >> 24) & 0xFF;
            bench_next_value++;
        }
        if (transmit) {
            uart->write(vec[i].data, nwords * 4U);
        }
        total += nwords * 4U;
    }
    return total;
}

void SerialLogger::rx_thread()
{
    uart->begin(baud, 65535, bench_kbps > 0 ? 4096 : 0);
    // bench mode transmits on this port; the Cube's own CTS input is unwired and
    // floats high, which would hold TX forever with hardware flow control on
    uart->set_flow_control((bench_kbps > 0 && bench_loop != 2) ? AP_HAL::UARTDriver::FLOW_CONTROL_DISABLE
                                          : AP_HAL::UARTDriver::FLOW_CONTROL_ENABLE);
    if (bench_kbps > 0 && bench_chunk > 0) {
        // each write must become its own wire chunk
        uart->set_unbuffered_writes(true);
    }

    while (true) {
#ifdef HAL_SLOG_RTS_LINE
        if (rts_pulse_request_us != 0) {
            // the driver only rewrites the line from its ISR when the ring is near
            // full, so a manual pulse here is left alone while the ring has room
            const uint32_t us = rts_pulse_request_us;
#ifdef HAL_SLOG_RX_DMA_STREAM
            const stm32_dma_stream_t *rx_dma = STM32_DMA_STREAM(HAL_SLOG_RX_DMA_STREAM);
            rts_pulse_ndtr_before = rx_dma->stream->NDTR;
#endif
#if HAL_UART_STATS_ENABLED
            rts_pulse_rx_before = uart->get_total_rx_bytes();
#endif
            rts_pulse_time_ms = AP_HAL::millis();
            palSetLine(HAL_SLOG_RTS_LINE);
            hal.scheduler->delay_microseconds(us);
#ifdef HAL_SLOG_RX_DMA_STREAM
            rts_pulse_ndtr_after = rx_dma->stream->NDTR;
#endif
#if HAL_UART_STATS_ENABLED
            rts_pulse_rx_after = uart->get_total_rx_bytes();
#endif
            palClearLine(HAL_SLOG_RTS_LINE);
            rts_pulse_request_us = 0;
            rts_pulses_done++;
        }
#endif
        if (bench_kbps > 0 && bench_loop == 0) {
            bench_generate();
            hal.scheduler->delay(1);
        } else {
            if (bench_kbps > 0 && bench_loop == 1) {
                bench_transmit();
            }
            if (ring->space() < SLOG_READ_CHUNK_BYTES) {
                // ring nearly full: stop reading so the driver ring fills and RTS drops
                hal.scheduler->delay(1);
            } else {
                if (!uart->wait_timeout(1, 5)) {
                    // HALs without wait support (SITL) return false immediately
                    hal.scheduler->delay_microseconds(500);
                }
                ByteBuffer::IoVec vec[2];
                const uint8_t nvec = ring->reserve(vec, MIN(SLOG_READ_CHUNK_BYTES, ring->space()));
                uint32_t total = 0;
                for (uint8_t i = 0; i < nvec; i++) {
                    const ssize_t n = uart->read(vec[i].data, MIN(vec[i].len, 65535U));
                    if (n <= 0) {
                        break;
                    }
                    if (bench_kbps > 0 && bench_loop != 0) {
                        bench_verify(vec[i].data, n);
                    }
                    total += n;
                    if (uint32_t(n) < vec[i].len) {
                        break;
                    }
                }
                ring->commit(total);
            }
        }
        ring_high_water_bytes = MAX(ring_high_water_bytes, ring->available());
    }
}

#endif // AP_PERIPH_SERIAL_LOGGER_ENABLED
